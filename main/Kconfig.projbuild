## main/Kconfig.projbuild
```kconfig
menu "Xiaozhi Assistant"

config OTA_URL
    string "Default OTA URL"
    default "https://api.tenclass.net/xiaozhi/ota/"
    help
        The application will access this URL to check for new firmwares and server address.

choice
    prompt "Flash Assets"
    default FLASH_DEFAULT_ASSETS
    help
        Select the assets to flash.

    config FLASH_NONE_ASSETS
        bool "Do not flash assets"
    config FLASH_DEFAULT_ASSETS
        bool "Flash Default Assets"
    config FLASH_CUSTOM_ASSETS
        bool "Flash Custom Assets"
endchoice

config CUSTOM_ASSETS_FILE
    depends on FLASH_CUSTOM_ASSETS
    string "Custom Assets File"
    default "assets.bin"
    help
        The custom assets file to flash.
        It can be a local file relative to the project directory or a remote url.

choice
    prompt "Default Language"
    default LANGUAGE_ZH_CN
    help
        Select device display language

    config LANGUAGE_ZH_CN
        bool "Chinese"
    config LANGUAGE_ZH_TW
        bool "Chinese Traditional"
    config LANGUAGE_EN_US
        bool "English"
    config LANGUAGE_JA_JP
        bool "Japanese"
    config LANGUAGE_KO_KR
        bool "Korean"
    config LANGUAGE_VI_VN
        bool "Vietnamese"
    config LANGUAGE_TH_TH
        bool "Thai"
    config LANGUAGE_DE_DE
        bool "German"
    config LANGUAGE_FR_FR
        bool "French"
    config LANGUAGE_ES_ES
        bool "Spanish"
    config LANGUAGE_IT_IT
        bool "Italian"
    config LANGUAGE_RU_RU
        bool "Russian"
    config LANGUAGE_AR_SA
        bool "Arabic"
    config LANGUAGE_HI_IN
        bool "Hindi"
    config LANGUAGE_PT_PT
        bool "Portuguese"
    config LANGUAGE_PL_PL
        bool "Polish"
    config LANGUAGE_CS_CZ
        bool "Czech"
    config LANGUAGE_FI_FI
        bool "Finnish"
    config LANGUAGE_TR_TR
        bool "Turkish"
    config LANGUAGE_ID_ID
        bool "Indonesian"
    config LANGUAGE_UK_UA
        bool "Ukrainian"
    config LANGUAGE_RO_RO
        bool "Romanian"
    config LANGUAGE_BG_BG
        bool "Bulgarian"
    config LANGUAGE_CA_ES
        bool "Catalan"
    config LANGUAGE_DA_DK
        bool "Danish"
    config LANGUAGE_EL_GR
        bool "Greek"
    config LANGUAGE_FA_IR
        bool "Persian"
    config LANGUAGE_FIL_PH
        bool "Filipino"
    config LANGUAGE_HE_IL
        bool "Hebrew"
    config LANGUAGE_HR_HR
        bool "Croatian"
    config LANGUAGE_HU_HU
        bool "Hungarian"
    config LANGUAGE_MS_MY
        bool "Malay"
    config LANGUAGE_NB_NO
        bool "Norwegian"
    config LANGUAGE_NL_NL
        bool "Dutch"
    config LANGUAGE_SK_SK
        bool "Slovak"
    config LANGUAGE_SL_SI
        bool "Slovenian"
    config LANGUAGE_SV_SE
        bool "Swedish"
    config LANGUAGE_SR_RS
        bool "Serbian"
endchoice

choice BOARD_TYPE
    prompt "Board Type"
    default BOARD_TYPE_VIBRATALKIE
    help
        Board type. 开发板类型    
    config BOARD_TYPE_VIBRATALKIE
        bool "Vibratalkie"
        depends on IDF_TARGET_ESP32S3
endchoice

choice DISPLAY_STYLE
    prompt "Select display style"
    default USE_DEFAULT_MESSAGE_STYLE
    help
        Select display style for Xiaozhi device

    config USE_DEFAULT_MESSAGE_STYLE
        bool "Enable default message style"

    config USE_WECHAT_MESSAGE_STYLE
        bool "Enable WeChat Message Style"

    config USE_EMOTE_MESSAGE_STYLE
        bool "Emote animation style"
endchoice

choice WAKE_WORD_TYPE
    prompt "Wake Word Implementation Type"
    default USE_AFE_WAKE_WORD if (IDF_TARGET_ESP32S3 || IDF_TARGET_ESP32P4) && SPIRAM
    default WAKE_WORD_DISABLED
    help
        Choose the type of wake word implementation to use

    config WAKE_WORD_DISABLED
        bool "Disabled"
        help
            Disable wake word detection

    config USE_ESP_WAKE_WORD
        bool "Wakenet model without AFE"
        depends on IDF_TARGET_ESP32C3 || IDF_TARGET_ESP32C5 || IDF_TARGET_ESP32C6 || (IDF_TARGET_ESP32 && SPIRAM)
        help
            Support ESP32 C3、ESP32 C5 与 ESP32 C6, and (ESP32 with PSRAM)

    config USE_AFE_WAKE_WORD
        bool "Wakenet model with AFE"
        depends on (IDF_TARGET_ESP32S3 || IDF_TARGET_ESP32P4) && SPIRAM
        help
            Support AEC if available, requires ESP32 S3 and PSRAM

    config USE_CUSTOM_WAKE_WORD
        bool "Multinet model (Custom Wake Word)"
        depends on (IDF_TARGET_ESP32S3 || IDF_TARGET_ESP32P4) && SPIRAM
        help
            Requires ESP32 S3 and PSRAM

endchoice

config CUSTOM_WAKE_WORD
    string "Custom Wake Word"
    default "xiao tu dou"
    depends on USE_CUSTOM_WAKE_WORD
    help
        Custom Wake Word, use pinyin for Chinese, separated by spaces

config CUSTOM_WAKE_WORD_DISPLAY
    string "Custom Wake Word Display"
    default "小土豆"
    depends on USE_CUSTOM_WAKE_WORD
    help
        Greeting sent to the server after wake word detection

config CUSTOM_WAKE_WORD_THRESHOLD
    int "Custom Wake Word Threshold (%)"
    default 20
    range 1 99
    depends on USE_CUSTOM_WAKE_WORD
    help
        Custom Wake Word Threshold, range 1-99, the smaller the more sensitive, default 20

config SEND_WAKE_WORD_DATA
    bool "Send Wake Word Data"
    default y
    depends on USE_AFE_WAKE_WORD || USE_CUSTOM_WAKE_WORD
    help
        Send wake word data to the server as the first message of the conversation and wait for response

config USE_AUDIO_PROCESSOR
    bool "Enable Audio Noise Reduction"
    default y
    depends on (IDF_TARGET_ESP32S3 || IDF_TARGET_ESP32P4) && SPIRAM
    help
        Requires ESP32 S3 and PSRAM

config USE_DEVICE_AEC
    bool "Enable Device-Side AEC"
    default y
    depends on USE_AUDIO_PROCESSOR && BOARD_TYPE_VIBRATALKIE
    help
        To work properly, device-side AEC requires a clean output reference path from the speaker signal and physical acoustic isolation between the microphone and speaker.

config USE_SERVER_AEC
    bool "Enable Server-Side AEC (Unstable)"
    default n
    depends on USE_AUDIO_PROCESSOR
    help
        To work perperly, server-side AEC requires server support

config USE_AUDIO_DEBUGGER
    bool "Enable Audio Debugger"
    default n
    help
        Enable audio debugger, send audio data through UDP to the host machine

config AUDIO_DEBUG_UDP_SERVER
    string "Audio Debug UDP Server Address"
    default "192.168.2.100:8000"
    depends on USE_AUDIO_DEBUGGER
    help
        UDP server address, format: IP:PORT, used to receive audio debugging data

config USE_ACOUSTIC_WIFI_PROVISIONING
    bool "Enable Acoustic WiFi Provisioning"
    default n
    help
        Enable acoustic WiFi provisioning, use audio signal to transmit WiFi configuration data

config RECEIVE_CUSTOM_MESSAGE
    bool "Enable Custom Message Reception"
    default n
    help
        Enable custom message reception, allow the device to receive custom messages from the server (preferably through the MQTT protocol)

menu "VIBRATALKIE_CONFIG"
    depends on BOARD_TYPE_VIBRATALKIE

    config PC_RAW_STREAM_MODE
        bool "Enable PC raw audio/ADC server mode"
        default n
        help
            Disable the cloud dialog protocol and stream timestamped native PCM and
            ADS1115 raw samples to a PC over UDP. The same UDP port accepts 24 kHz,
            mono, signed 16-bit PCM for speaker playback.

    config PC_RAW_STREAM_SERVER
        string "PC server IPv4 address"
        default "255.255.255.255"
        depends on PC_RAW_STREAM_MODE
        help
            Keep the default broadcast address for automatic discovery. The PC
            replies from UDP port 9999 and the device then switches to its unicast IP.

    config PC_RAW_STREAM_PORT
        int "PC raw stream UDP port"
        default 9999
        range 1024 65535
        depends on PC_RAW_STREAM_MODE

    config PC_RAW_STREAM_ADC_RATE
        int "ADS1115 sample rate (samples/second)"
        default 800
        range 1 860
        depends on PC_RAW_STREAM_MODE

    choice DISPLAY_LCD_VIBRATALKIE
        prompt "LCD Display Type"
        default DISPLAY_USE_ST7789
        help
            选择LCD显示屏类型
        config DISPLAY_USE_GC9D01
            bool "Use GC9D01 LCD (160x160)"
        config DISPLAY_USE_GC9A01
            bool "Use GC9A01 LCD (240x240)"
        config DISPLAY_USE_ST7789
            bool "Use ST7789 LCD (240x240)"
    endchoice

endmenu

endmenu
```
